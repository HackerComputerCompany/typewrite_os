## buildroot-2024.02/configs/typewrite_i686_defconfig
```kconfig
# Typewrite OS - i686 (32-bit) Buildroot Config
# For MacBook Air 2010 and other 32-bit EFI systems

BR2_i686=y

# System
BR2_TARGET_GENERIC_GETTY_PORT="tty0"

# Boot
BR2_TARGET_SYSLINUX=y

# Kernel
BR2_LINUX_KERNEL=y
BR2_LINUX_KERNEL_CUSTOM_VERSION=y
BR2_LINUX_KERNEL_CUSTOM_VERSION_VALUE="6.1.44"
BR2_LINUX_KERNEL_USE_CUSTOM_CONFIG=y
BR2_LINUX_KERNEL_CUSTOM_CONFIG_FILE="board/typewrite/linux-i686.config"

# Filesystem
BR2_TARGET_ROOTFS_EXT2=y
BR2_TARGET_ROOTFS_EXT2_SIZE="120M"

# Packages
BR2_PACKAGE_BUSYBOX=y
BR2_PACKAGE_TYPEWRITE=y
BR2_PACKAGE_BOOTLOGO=y
```

## buildroot-2024.02/configs/typewrite_jasperlake_defconfig
```kconfig
# Typewrite OS - Jasper Lake / Intel UHD Graphics with VAAPI
# Target: Modern laptops with Intel Jasper Lake (UHD Graphics)
# Features: VAAPI hardware video acceleration, OpenGL via Mesa iris
# Note: No networking - focused on minimal footprint

# Architecture
BR2_x86_64=y

# System
BR2_TARGET_GENERIC_GETTY_PORT="tty0"

# Boot
BR2_TARGET_SYSLINUX=y

# Kernel
BR2_LINUX_KERNEL=y
BR2_LINUX_KERNEL_CUSTOM_VERSION=y
BR2_LINUX_KERNEL_CUSTOM_VERSION_VALUE="6.1.44"
BR2_LINUX_KERNEL_USE_CUSTOM_CONFIG=y
BR2_LINUX_KERNEL_CUSTOM_CONFIG_FILE="board/typewrite/linux-jasperlake.config"

# Filesystem
BR2_TARGET_ROOTFS_EXT2=y
BR2_TARGET_ROOTFS_EXT2_SIZE="120M"
BR2_ROOTFS_POST_BUILD_SCRIPT="board/typewrite/post-build.sh"

# Image
BR2_ROOTFS_POST_IMAGE_SCRIPT="board/qemu/post-image.sh"

# Packages
BR2_PACKAGE_BUSYBOX=y
BR2_PACKAGE_TYPEWRITE=y
BR2_PACKAGE_BOOTLOGO=y

# VAAPI and Hardware Acceleration
BR2_PACKAGE_LIBVA=y
BR2_PACKAGE_LIBVA_UTILS=y
BR2_PACKAGE_LIBVA_INTEL_DRIVER=y

# Mesa for OpenGL (Intel iris driver for Jasper Lake)
BR2_PACKAGE_MESA3D=y
BR2_PACKAGE_MESA3D_DRI_DRIVER_GROUP="i915 iris"
BR2_PACKAGE_MESA3D_GALLIUM_DRIVER_GROUP="i915 iris"

# libdrm for DRM/i915
BR2_PACKAGE_LIBDRM=y
BR2_PACKAGE_LIBDRM_INTEL=y

# Firmware
BR2_PACKAGE_FIRMWARE_INTEL=y

# Debug tools
BR2_PACKAGE_STRACE=y
```

## buildroot-2024.02/package/bootlogo/Config.in
```kconfig
config BR2_PACKAGE_BOOTLOGO
	bool "bootlogo"
	select BR2_PACKAGE_FREETYPE
	help
	  Boot logo for Typewrite OS - displays a retro typewriter
	  splash screen on boot.
```

## buildroot-2024.02/package/typewrite/Config.in
```kconfig
config BR2_PACKAGE_TYPEWRITE
	bool "typewrite"
	help
	  Typewriter simulator for Linux console
```
